## gpio_button_debounce/main/Kconfig.projbuild
```kconfig
menu "Button debounce assignment"
    config BUTTON_GPIO
        int "Confirmed external button GPIO (-1 disables hardware)"
        range -1 48
        default -1
        help
            Set only after confirming board pinout and wiring. Active LOW,
            external 10 kohm pull-up to 3.3 V. Internal pulls are disabled.
    config BUTTON_START_MODE
        int "Initial mode: 1 raw, 2 time, 3 state, 4 polling"
        range 1 4
        default 1
endmenu
```

## relay_delay/main/Kconfig.projbuild
```kconfig
menu "Relay delay measurement"
    config RELAY_WIRING_CONFIRMED
        bool "Wiring and 3.3 V compatibility have been confirmed"
        default n
        help
            Enable only after verifying the driver, its active level and both
            GPIOs. COM must connect to ESP32 GND and NO to the input, with no
            external voltage on the dry contacts. Disabled means no GPIO setup.

    config RELAY_DRIVE_GPIO
        int "Relay driver GPIO (-1 = unspecified)"
        range -1 48
        default -1

    config RELAY_CONTACT_GPIO
        int "Dry NO contact GPIO (-1 = unspecified)"
        range -1 48
        default -1

    config RELAY_ACTIVE_LEVEL
        int "Driver active level (0 = LOW, 1 = HIGH)"
        range 0 1
        default 1

    config RELAY_CYCLES
        int "Number of ON/OFF cycles"
        range 10 100
        default 10

    config RELAY_DEBOUNCE_MS
        int "Required quiet contact interval (ms)"
        range 1 100
        default 10

    config RELAY_TIMEOUT_MS
        int "Transition timeout including confirmation (ms)"
        range 200 5000
        default 1000

    config RELAY_HOLD_MS
        int "Hold time after each successful measurement (ms)"
        range 100 5000
        default 250
endmenu
```

## relay_delay/sdkconfig.defaults
```kconfig
CONFIG_IDF_TARGET="esp32s3"
CONFIG_ESPTOOLPY_FLASHSIZE_16MB=y
CONFIG_ESP_CONSOLE_UART_DEFAULT=y
CONFIG_ESP_CONSOLE_SECONDARY_NONE=y
# CONFIG_SPIRAM is not set
CONFIG_RELAY_WIRING_CONFIRMED=y
CONFIG_RELAY_DRIVE_GPIO=4
CONFIG_RELAY_CONTACT_GPIO=5
CONFIG_RELAY_ACTIVE_LEVEL=1
```
